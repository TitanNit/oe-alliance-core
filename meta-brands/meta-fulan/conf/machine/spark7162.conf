## meta-brands/meta-fulan/conf/machine/spark7162.conf
```bitbake
require conf/machine/include/fulan-oem.inc

SOC_FAMILY = "sti7162"

EXTRA_IMAGEDEPENDS += "\
"

MACHINE_EXTRA_RDEPENDS += "\
"

MACHINE_ESSENTIAL_EXTRA_RDEPENDS += " \
    stlinux24-sh4-stmfb-firmware-stx7105 \
"
```
